## main/Kconfig.projbuild
```kconfig
menu "projbuild Connection Configuration"

    choice WIFI_MODE_SELECTION
        prompt "WiFi mode"
        default SET_MODE_AP
        help
            WiFi mode (WIFI_AP, WIFI_STA or WIFI_NO) for the Esp32.

        config SET_MODE_AP
            bool "WIFI_AP"
        config SET_MODE_STA
            bool "WIFI_STA"
        config SET_MODE_NO
            bool "WIFI_NO"
    endchoice
	
	config WIFI_CHANNEL
        int "WiFi Channel"
		range 1 13
        default 1
        help
            Default WiFi channel for the example to use.

    config WIFI_STA_MAXIMUM_RETRY
        int "Maximum retry"
        default 5
        help
            Set the Maximum retry to avoid station reconnecting to the AP unlimited when the AP is really inexistent.
	
    config WIFI_AP_MAXIMUM_CONN
        int "Maximum connections"
        default 3
        help
            Set the Maximum devices that can connect to the AP.	
				
endmenu
```
